## arch/arm/mach-bhyve/Kconfig
```kconfig
if ARCH_BHYVE

config SYS_VENDOR
	default "emulation"

config SYS_BOARD
	default "bhyve-arm"

config SYS_CONFIG_NAME
	default "bhyve-arm64"

endif
```

## board/fpga/fett-riscv/Kconfig
```kconfig
if TARGET_FETT_RISCV

config SYS_BOARD
	default "fett-riscv"

config SYS_VENDOR
	default "fpga"

config SYS_CPU
	default "generic"

config SYS_CONFIG_NAME
	default "fett-riscv"

config SYS_TEXT_BASE
	default 0xC1200000 if SPL
	default 0xC0000000 if !RISCV_SMODE
	default 0xC0200000 if RISCV_SMODE && ARCH_RV64I
	default 0xC0400000 if RISCV_SMODE && ARCH_RV32I

config SPL_TEXT_BASE
	default 0xC0000000

config SPL_OPENSBI_LOAD_ADDR
	hex
	default 0xC1000000

config BOARD_SPECIFIC_OPTIONS # dummy
	def_bool y
	select GENERIC_RISCV
	select SUPPORT_SPL
	imply SYS_NS16550
	imply VIRTIO_MMIO
	imply VIRTIO_NET
	imply VIRTIO_BLK
	imply VIRTIO_PCI
	imply CMD_PING
	imply CMD_FS_GENERIC
	imply DOS_PARTITION
	imply EFI_PARTITION
	imply ISO_PARTITION
	imply CMD_EXT2
	imply CMD_EXT4
	imply CMD_FAT
	imply BOARD_LATE_INIT
	imply SIFIVE_SERIAL
	imply SMP
	imply PCI
	imply DM_PCI
	imply PCIE_ECAM_GENERIC
	imply CMD_PCI
	imply E1000
	imply NVME
	imply SPL_RAM_SUPPORT
	imply SPL_RAM_DEVICE
	imply SYSRESET
	imply SYSRESET_SYSCON
	imply CMD_POWEROFF
	imply SYSRESET_CMD_POWEROFF

endif
```

## configs/bhyve_arm64_defconfig
```kconfig
CONFIG_ARM=y
# CONFIG_ARM64_CRC32 is not set
CONFIG_ARCH_BHYVE=y
CONFIG_DEFAULT_DEVICE_TREE="bhyve"
CONFIG_SYS_LOAD_ADDR=0x100000000
CONFIG_DISTRO_DEFAULTS=y
# CONFIG_SYS_MALLOC_CLEAR_ON_INIT is not set
# CONFIG_DISPLAY_CPUINFO is not set
# CONFIG_DISPLAY_BOARDINFO is not set
# CONFIG_CMD_BOOTEFI_HELLO is not set
CONFIG_CMD_BOOTEFI_SELFTEST=y
CONFIG_CMD_DM=y
CONFIG_CMD_PCI=y
CONFIG_CMD_HVC=y
CONFIG_OF_CONTROL=y
CONFIG_OF_BOARD=y
CONFIG_BLK=y
# CONFIG_MMC is not set
CONFIG_DM_ETH=y
CONFIG_PCI=y
CONFIG_PCIE_ECAM_GENERIC=y
CONFIG_CONS_INDEX=0
CONFIG_PL011_SERIAL=y
CONFIG_SYSRESET=y
CONFIG_SYSRESET_PSCI=y
CONFIG_VIRTIO_PCI=y
CONFIG_VIRTIO_BLK=y
# CONFIG_FAT_WRITE is not set
```
